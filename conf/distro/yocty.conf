## conf/distro/yocty.conf
```bitbake
require conf/distro/poky.conf

DISTRO = "yocty"
DISTRO_NAME = "distro description"
DISTRO_VERSION = "1.0"
MAINTAINER = "atitep.ram@gmail.com"
```

## conf/machine/bootlinlabs.conf
```bitbake
require conf/machine/include/st-machine-common-stm32mp.inc
require conf/machine/include/st-machine-providers-stm32mp.inc
require conf/machine/include/arm/armv7a/tune-cortexa7.inc

DEFAULTTUNE = "cortexa7thf-neon-vfpv4"

# U-Boot configuration
UBOOT_CONFIG = "trusted_stm32mp15"

# Device tree files for SD card
STM32MP_DT_FILES_SDCARD = "stm32mp157a-dk1 stm32mp157d-dk1"

# Add m4copro to machine features
MACHINE_FEATURES:append = " m4copro"
```
